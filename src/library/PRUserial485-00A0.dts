/dts-v1/;
/plugin/;

/ {
        compatible = "ti,beaglebone", "ti,beaglebone-black", "ti,beaglebone-green";

        /* identification */
        part-number = "PRUserial485";
        version = "00A0";

        /* state the resources this cape uses */
        exclusive-use =
                // PRU resources used
                "pruss",
                "pru1",
                // PRU Input pins
		        "P8.46","pr1_pru1_pru_r31_1", // MISO
				"P8.39","pr1_pru1_pru_r31_6", // IRQ
				"P8.27","pr1_pru1_pru_r31_8", // SYNC
                // PRU Output pins
				"P8.45","pr1_pru1_pru_r30_0", // CLK
				"P8.43","pr1_pru1_pru_r30_2", // CS
		        "P8.41","pr1_pru1_pru_r30_4", // MOSI

		// PRU Output LEDS
				"P8.28","pr1_pru1_pru_r30_10",// LED ALIVE
				"P8.29","pr1_pru1_pru_r30_9", // LED WRITE
				"P8.40","pr1_pru1_pru_r30_7"; // LED READ


    // MUX Bit Maps:
    // 0x40 = slow slew (0 = fast slew)
    // 0x20 = input (0 = output)
    // 0x10 = pullup, 0x08 = disabled (0 = pulldown)
    // 0x01 to 0x07 = mode 1 to 7

   fragment@0 {
        target = <&am33xx_pinmux>;
        __overlay__ {
	 pruss_pins: pruss_pins {
                pinctrl-single,pins = <
                    0x0a4 0x36
                    0x0b8 0x36
                    0x0e0 0x36

                    0x0a0 0x0D
                    0x0a8 0x0D
                    0x0b0 0x0D

					0x0e8 0x0D
					0x0e4 0x0D
					0x0bc 0x0D
                >;
            };
        };
    };


    fragment@10 {
        target = <&pruss>;
        __overlay__ {
            status = "okay";  
            pinctrl-names = "default";
            pinctrl-0     = <&pruss_pins>; 
        };
    };
};